## config/boards/arm/bt60/Kconfig
```kconfig
# SPDX-License-Identifier: MIT

config BOARD_ENABLE_DCDC
	bool "Enable DCDC mode"
	select SOC_DCDC_NRF52X
	default y
	depends on BOARD_BT60

CONFIG_BT_CTLR_TX_PWR_PLUS_8=y
# Lower USB polling interval
CONFIG_USB_HID_POLL_INTERVAL_MS=1

# Lower debounce
CONFIG_ZMK_KSCAN_DEBOUNCE_PRESS_MS=0
CONFIG_ZMK_KSCAN_DEBOUNCE_RELEASE_MS=5
```

## config/boards/arm/bt60/Kconfig.board
```kconfig
# BT60 board configuration

# Copyright (c) 2021 Polarity Works
# SPDX-License-Identifier: MIT

config BOARD_BT60
	bool "bt60"
	depends on SOC_NRF52840_QIAA

CONFIG_BT_CTLR_TX_PWR_PLUS_8=y
# Lower USB polling interval
CONFIG_USB_HID_POLL_INTERVAL_MS=1

# Lower debounce
CONFIG_ZMK_KSCAN_DEBOUNCE_PRESS_MS=0
CONFIG_ZMK_KSCAN_DEBOUNCE_RELEASE_MS=5
```
